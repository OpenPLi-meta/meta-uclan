## conf/machine/ustym4kpro.conf
```bitbake
#@TYPE: Machine
#@NAME: ustym4kpro
#@DESCRIPTION: Machine configuration for the ustym4kpro

SOC_FAMILY = "hisi3798mv200"
CHIPSET = "Hi3798Mv200"
HICHIPSET = "3798mv200"

BRAND_OEM = "uclan"
MACHINE_BRAND = "Uclan"
MACHINE_NAME = "Ustym 4K PRO"

MTD_ROOTFS = "mmcblk0p16"
MTD_KERNEL = "mmcblk0p12"
KERNEL_FILE = "kernel.bin"
ROOTFS_FILE = "rootfs.tar.bz2"
MTD_BLACK  = "mmcblk0"

MACHINE_FEATURES += " textlcd 7segment blindscan hisil mali transcoding emmc skins1080 no-subssupport fastboot HDMI AV_JACK HDMISTANDBY"
OPENPLI_FEATURES += " qtplugins kodi openhbbtvbrowser"
DISTRO_FEATURES:remove = "x11 wayland"

EXTRA_OECONF_append_pn-enigma2 = "--with-lcddev=/dev/null --with-alphablendingacceleration=always --with-blitaccelerationthreshold=250  --with-fillaccelerationthreshold=190000"

require conf/machine/include/uclan-hisi.inc
```
